## drivers/clk/realtek/Kconfig
```kconfig
# SPDX-License-Identifier: GPL-2.0-only
config CLK_RTD129X_SCPU
	tristate "Realtek RTD129x SCPU (CPU) PLL clock"
	depends on ARCH_REALTEK || COMPILE_TEST
	depends on MFD_SYSCON
	help
	  This enables the CPU PLL clock driver for Realtek RTD129x SoCs,
	  needed for CPU frequency scaling (cpufreq-dt).
```

## drivers/soc/realtek/Kconfig
```kconfig
# SPDX-License-Identifier: GPL-2.0-only
menu "Realtek SoC drivers"

config RTK_RSVMEM_REMAP
	bool "Realtek reserved-memory remap helper (vendor)"
	depends on OF_RESERVED_MEM
	help
	  Vendor helper for reserved-memory nodes with:
	    compatible = "rsvmem-remap"
	    save_remap_name = "rbus" | "common" | "ringbuf"

	  It ioremaps the reserved region early and stores the mapping for
	  other vendor drivers to use.

endmenu
```
